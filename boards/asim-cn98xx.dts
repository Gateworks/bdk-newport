/***********************license start***********************************
* Copyright (C) 2018 Marvell International Ltd.
* SPDX-License-Identifier: BSD-3-Clause
* https://spdx.org/licenses
***********************license end**************************************/
/dts-v1/;

/ {
cavium,bdk {
	/* Some boards shipped with BOARD-MAC-ADDRESS-NUM programmed
	incorrectly. This value overrides the setting in flash of
	BOARD-MAC-ADDRESS-NUM, allowing correction of the value. This
	should normally not be used.
	 */
	//BOARD-MAC-ADDRESS-NUM-OVERRIDE = "-1";

	/* Maximum Core clock (RCLK) frequency in MHz. DVFS control will vary the
	actual RCLK frequency depending on Tj, power budget, and system load;
	this sets an upper bound.  If fuses indicate the part supports a lower
	frequency, the fuse value is used.  Valid range is 500MHz-3300MHz. Doesn't
	apply to CN8XXX chips. */
	//RCLK-FREQ-MAX.N%d = "0x1f4";
	RCLK-FREQ-MAX = "1000";

	/* Minimum Core clock (RCLK) frequency in MHz. DVFS control will vary the
	actual RCLK frequency depending on Tj, power budget, and system load;
	this sets the lower bound.  Default value 500MHz.  WARNING- setting
	this above 500MHz may result in excess power consumption and sudden
	thermal shutdown. Valid range is 500MHz-3300MHz. Doesn't apply to
	CN8XXX chips. */
	//RCLK-FREQ-MIN.N%d = "0x1f4";
	RCLK-FREQ-MIN = "1000";

	/* Coprocessor clock (SCLK) frequency in MHz. Valid range is
	500MHz-1200MHz. Doesn't apply to CN8XXX chips. */
	//SCLK-FREQ.N%d = "0x1f4";
	SCLK-FREQ = "1000";

	/* Cryptographic accelerator clock (CPTCLK) frequency in MHz. If fuses
	indicate the part supports a lower frequency, the fuse value is used.
	Valid range 800MHz-1600MHz. Doesn't apply to CN8XXX chips. */
	//CPTCLK-FREQ.N%d = "0x320";
	CPTCLK-FREQ = "1000";

	/* Set the mode of a QLM/DLM. The possible mode strings are:
	    DISABLED     # CN83XX: All             CN81XX: All         CN80XX: All         CN96XX: All
	    PCIE_X1      #                                             CN80XX: DLM0
	    PCIE_X2      # CN83XX: DLM4,5          CN81XX: DLM0,2,3    CN80XX: DLM0,2,3    CN96XX: DLM4,5
	    PCIE_X4      # CN83XX: QLM0-3,DLM5     CN81XX: DLM0,2      CN80XX: DLM2        CN96XX: QLM0,1,2,3,6,7, DLM4-5
	    PCIE_X8      # CN83XX: QLM0,2                                                  CN96XX: QLM0-1,6-7
	    PCIE_X16     #                                                                 CN96XX: QLM0-3
	    PCIE_X4-EP   #                                                                 CN96XX: QLM0,3,6
	    PCIE_X8-EP   #                                                                 CN96XX: QLM0-1,6-7
	    PCIE_X16-EP  #                                                                 CN96XX: QLM0-3
	    SATA         # CN83XX: DLM4,5          CN81XX: DLM3        CN80XX: DLM3        CN96XX: DLM4,5
	    SGMII        # CN83XX: QLM2-6          CN81XX: DLM0-3      CN80XX: DLM0-3      CN96XX: QLM3-7
	    1G_X         # CN83XX: QLM2-6          CN81XX: DLM0-3      CN80XX: DLM0-3      CN96XX: QLM3-7
	    QSGMII       # CN83XX: QLM2-4,DLM4,5   CN81XX: DLM0-3      CN80XX: DLM0-3      CN96XX: QLM3,6,7,DLM4,5
	    XAUI         # CN83XX: QLM3,4          CN81XX: DLM0,2      CN80XX: DLM2        CN96XX: QLM3,6,7
	    RXAUI        # CN83XX: QLM3-6          CN81XX: DLM0-3      CN80XX: DLM2        CN96XX: QLM3-7
	    XFI          # CN83XX: QLM2-6          CN81XX: DLM0-3      CN80XX: DLM0-3      CN96XX: QLM3-7
	    SFI          #                                                                 CN96XX: QLM3-7
	    XLAUI        # CN83XX: QLM3,4          CN81XX: DLM0,2      CN80XX: DLM2        CN96XX: QLM3,6,7
	    XLAUI_C2M    #                                                                 CN96XX: QLM3,6,7
	    10G_KR       # CN83XX: QLM3-6          CN81XX: DLM0-3      CN80XX: DLM0-3      CN96XX: QLM3-7
	    40G_CR4      # CN83XX: QLM3,4,DLM5     CN81XX: DLM0,2      CN80XX: DLM2        CN96XX: QLM3,6,7
	    40G_KR4      # CN83XX: QLM3,4,DLM5     CN81XX: DLM0,2      CN80XX: DLM2        CN96XX: QLM3,6,7
	    20GAUI_C2C   #                                                                 CN96XX: QLM3-7
	    25GAUI_C2C   #                                                                 CN96XX: QLM3-7
	    25GAUI_C2M   #                                                                 CN96XX: QLM3-7
	    25G_CR       #                                                                 CN96XX: QLM3-7
	    25G_KR       #                                                                 CN96XX: QLM3-7
	    25GAUI_2_C2C #                                                                 CN96XX: QLM3-7
	    40GAUI_2_C2C #                                                                 CN96XX: QLM3-7
	    50GAUI_2_C2C #                                                                 CN96XX: QLM3-7
	    50GAUI_2_C2M #                                                                 CN96XX: QLM3-7
	    50G_CR2      #                                                                 CN96XX: QLM3-7
	    50G_KR2      #                                                                 CN96XX: QLM3-7
	    50GAUI_4_C2C #                                                                 CN96XX: QLM3,6,7
	    80GAUI_4_C2C #                                                                 CN96XX: QLM3,6,7
	    CAUI_4_C2C   #                                                                 CN96XX: QLM3,6,7
	    CAUI_4_C2M   #                                                                 CN96XX: QLM3,6,7
	    100G_CR4     #                                                                 CN96XX: QLM3-7
	    100G_KR4     #                                                                 CN96XX: QLM3-7
	    USXGMII_4X1  #                                                                 CN96XX: QLM3,6,7,DLM4,5
	    USXGMII_2X1  #                                                                 CN96XX: QLM3,6,7,DLM4,5
	    USXGMII_1X1  #                                                                 CN96XX: QLM3,6,7,DLM4,5
	Parameters:
	    N#: Parameter can be different for each node. This specifies
	        which node the value is for. Node must be 0-3. Optional.
	    QLM#: Parameter can be different for each DLM/QLM. Optional.
	    LANE#: Parameter can be different for each DLM/QLM lane. Optional. */
	//QLM-MODE.N%d.QLM%d.LANE%d = "";
	QLM-MODE.N0.QLM9 = "XFI";
	QLM-MODE.N0.QLM10 = "XLAUI";
	QLM-MODE.N0.QLM11 = "25G_CR";
	QLM-MODE.N0.QLM12 = "50G_CR2";
	QLM-MODE.N0.QLM13 = "100G_CR4";

	/* Set the speed of a QLM/DLM in Mhz. The possible speeds are:
	    1250 # Networking SGMII,1G_X
	    1500 # SATA Gen1
	    2500 # PCIe Gen1, Networking SGMII
	    3000 # SATA Gen2
	    3125 # Networking XAUI
	    5000 # PCIe Gen2, Networking QSGMII
	    6000 # SATA Gen3
	    6250 # Networking XAUI,RXAUI
	    8000 # PCIe Gen3
	   10312 # Networking XFI,XLAUI,10G_KR,40G_CR4,40G_KR4
	   12890 # Networking 25GAUI_2, 50GAUI_4
	   16000 # PCIe Gen4 (CN9XXX)
	   20625 # Networking 20GAUI, 40GAUI_2, 80GAUI_4, USXGMII (CN9XXX)
	   25781 # Networking (CN9XXX)
	Parameters:
	    N#: Parameter can be different for each node. This specifies
	        which node the value is for. Node must be 0-3. Optional.
	    QLM#: Parameter can be different for each DLM/QLM. Optional.
	    LANE#: Parameter can be different for each DLM/QLM lane. Optional. */
	//QLM-FREQ.N%d.QLM%d.LANE%d = "0";
	QLM-FREQ.N0.QLM9 = "10312";
	QLM-FREQ.N0.QLM10 = "10312";
	QLM-FREQ.N0.QLM11 = "25781";
	QLM-FREQ.N0.QLM12 = "25781";
	QLM-FREQ.N0.QLM13 = "25781";

	/* Set the source of the QLM/DLM reference clock:
	    0 = Common clock 0 (CN9XXX 100 Mhz No SSC)
	    1 = Common clock 1 (CN9XXX 100 Mhz SSC)
	    2 = QLM/DLM external reference
	    3 = Common clock 2 (CN9XXX 156.25 Mhz)
	Parameters:
	    N#: Parameter can be different for each node. This specifies
	        which node the value is for. Node must be 0-3. Optional.
	    QLM#: Parameter can be different for each DLM/QLM. Optional. */
	//QLM-CLK.N%d.QLM%d = "4";
	QLM-CLK.N0.QLM9 = "3";
	QLM-CLK.N0.QLM10 = "3";
	QLM-CLK.N0.QLM11 = "3";
	QLM-CLK.N0.QLM12 = "3";
	QLM-CLK.N0.QLM13 = "3";

	/* Set the QLM/DLM reference clock termination, not used for CN8XXX:
	   -1 = No clock, powered down (default)
	    0 = No termination
	    1 = LVPECL termination
	    2 = Reserved
	    3 = HCSL termination */
	//QLM-CLK-TERM.N%d.QLM%d = "-1";
	QLM-CLK-TERM = "0";
};
};

