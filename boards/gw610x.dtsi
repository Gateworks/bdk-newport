/ {
cavium,bdk {
	BDK-BOOT-MENU-TIMEOUT = "2";

	/* Determine how multi-node is supported for this system:
	    0 = Multi-node is not supported
	    1 = Multi-node is supported and booting requires two nodes
	    2 = Multi-node is auto detected. Two nodes are used if
	        if available, otherwise fall back to single node. */
	MULTI-NODE = "0";

	/* QLM */
	QLM-AUTO-CONFIG = "0";
	QLM-MODE.N0.QLM0 = "DISABLED";
	QLM-MODE.N0.QLM1 = "DISABLED";
	QLM-MODE.N0.QLM2 = "DISABLED";
	/* PCIE 1x: Gen2 */
	QLM-MODE.N0.QLM3 = "PCIE_X1";
	QLM-FREQ.N0.QLM3 = "5000"; /* Gen1:2500 Gen2:5000 Gen3:8000 */
	QLM-CLK.N0.QLM3 = "1"; /* Common clock 1 */

	/*
	 * USB 3.0 Configuration
	 */
	/* USB0 PWR_EN is on GPIO22 */
	USB-PWR-GPIO.N0.PORT0 = "22";
	USB-PWR-GPIO-POLARITY.N0.PORT0 = "1";
	/* Specify reference clock source for SuperSpeed and HighSpeed PLL */
	USB-REFCLK-SRC.N0.PORT0 = "2"; /* DLMC_REF_CLK1 */
	USB-REFCLK-SRC.N0.PORT1 = "2"; /* DLMC_REF_CLK1 */

	/*
	 * BGX Configuration
	 */
	/* BGX0 unused */
	BGX-ENABLE.N0.BGX0.P0 = "0";
	BGX-ENABLE.N0.BGX0.P1 = "0";
	BGX-ENABLE.N0.BGX0.P2 = "0";
	BGX-ENABLE.N0.BGX0.P3 = "0";
	/* BGX1 unused */
	BGX-ENABLE.N0.BGX1.P0 = "0";
	BGX-ENABLE.N0.BGX1.P1 = "0";
	BGX-ENABLE.N0.BGX1.P2 = "0";
	BGX-ENABLE.N0.BGX1.P3 = "0";
	/* BGX2 RGMII  */
	BGX-ENABLE.N0.BGX2.P0 = "1";
	PHY-ADDRESS.N0.BGX2.P0 = "0xff000000"; /* MDIO0 addr0 */
}; /* cavium,bdk */
}; /* / */
