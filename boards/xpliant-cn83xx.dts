/dts-v1/;

/include/ "ddr4-common.dtsi"

/ {
cavium,bdk {
	/* On-chip TWSI port connected to the BMC for IPMI traffic.
	-1 = No connection exists. 0+ is TWSI bus number. */
	//BMC-TWSI = "-1";

	/* This specifies a watchdog timer should run during boot and reset
	the chip if boot hangs for some reason. The timeout is specified
	in milliseconds. Zero disables the watchdog. */
	//WATCHDOG-TIMEOUT = "0";

	/* Allow a sequence of TWSI writes to be performed during boot. Each
	string in the list line is executed in sequence. The TWSI write
	format is:
	    node,twsi_id,dev_addr,internal_addr,num_bytes,ia_width_bytes,data
	    sleep,ms
	    gpio,node,gpio_num,state
	node           = Node ID the twsi bus is on. -1 means the local node
	twsi_id        = TWSI bus to use
	dev_addr       = TWSI bus address
	internal_addr  = TWSI internal address, zero if not used
	num_bytes      = Number of bytes to write (1-8)
	ia_width_bytes = Internal address width in bytes (0-2)
	data           = Data to write as a 64bit number
	sleep,ms       = This on a line delays for 'ms' milliseconds
	gpio,...       = This sets the state of a GPIO gpio_num to 0 or 1 */
	//TWSI-WRITE = "";
    TWSI-WRITE = 
    /* Enable SATA port power */
    "gpio, 0, 63, 1",
    "sleep, 10";

	/* Set for ports which have aquantia phy attached 
	   Encoding
           When phy is not attached
           Bits[15:0] 0 - no aquantia phy
	   When aquantia phy is attached
           Bits[15:8]: SERDES lane number to use, 0xff use normal QLM/DLM mapping
                        used when mapping depends on dip switches
           Bits[7:0]: 1 - aquantia phy attached
        */
	//AQUANTIA-PHY.N%d.BGX%d.P%d = "";	

	/* Allow a sequence of MDIO writes to be performed during boot. Each
	string in the list line is executed in sequence. The MDIO write
	format is:
	    clause,node,bus_id,phy_id,device,location,val
	    sleep,ms
	    gpio,node,gpio_num,state
	clause   = MDIO clause for the write (22 or 45)
	node     = Node the MDIO bus is connected, -1 for local
	bus_id   = MDIO bus to use
	phy_id   = MDIO address
	device   = Clause 45 internal device address, zero for clause 22
	location = MDIO register
	val      = Value to write
	sleep,ms = This on a line delays for 'ms' milliseconds
	gpio,... = This sets the state of a GPIO gpio_num to 0 or 1 */
	//MDIO-WRITE = "";

	/* PHY address encoding:
	    Bits[31:24]: Node ID, 0xff for node the ethernet device is on
	    Bits[23:16]: Only used for TWSI
	    Bits[15:12]: PHY connection type (0=MDIO, 1=Fixed, 2=TWSI)
	For MDIO:
	    Bits[31:24]: Node ID, 0xff for node the ethernet device is on
	    Bits[23:16]: 0
	    Bits[15:12]: 0=MDIO
	    Bits[11:8]: MDIO bus number
	    Bits[7:0]: MDIO address
	For Fixed:
	    Bits[31:24]: 0
	    Bits[23:16]: Zero
	    Bits[15:12]: 1=Fixed
	    Bits[11:0]:  0 = 1Gb, 1 = 100Mb
	For TWSI:
	    Bits[31:24]: Node ID, 0xff for node the ethernet device is on
	    Bits[23:16]: TWSI internal address width in bytes (0-2)
	    Bits[15:12]: 2=TWSI
	    Bits[11:8]: TWSI bus number
	    Bits[7:0]: TWSI address */
	//PHY-ADDRESS.N%d.BGX%d.P%d = "-1";
	// When board is running as Node 0
	PHY-ADDRESS.N0.BGX2.P0 = "0xff00001f";

	/* Independent enables for each on-chip BGX port. Use this to
	disable ports that are not wired on a board. Default is that all
	ports are enabled. */
	//BGX-ENABLE.N%d.BGX%d.P%d = "1";
        BGX-ENABLE.N0.BGX3.P0 = "1";
        BGX-ENABLE.N0.BGX2.P0 = "1";
        BGX-ENABLE.N0.BGX1.P0 = "0";
        BGX-ENABLE.N0.BGX1.P1 = "0";
        

	/* Number of packet buffers in the BDK. */
	BDK-NUM-PACKET-BUFFERS = "0x1000";

	/* The size of each packet buffer in the BDK. */
	BDK-PACKET-BUFFER-SIZE = "0x400";

	/* Controls whether the BDK displays link status messages. */
	BDK-SHOW-LINK-STATUS = "1";

	/* Controls the cores used by the BDK. Zero means all cores. */
	BDK-COREMASK = "0";

	/* Timeout for the boot menu in seconds. */
	//BDK-BOOT-MENU-TIMEOUT = "0xa";

	/* This is used by the boot menu to control which boot path the init
	code chooses. The supported options are
	    0 = Normal boot path
	    1 = Diagnostics boot path */
	//BDK-BOOT-PATH-OPTION = "0";

	/* This is used by the boot apps to determine the next boot stage.
	    e.g.:
	      BDK-CONFIG-BOOT-NEXT-STAGE-INIT=/fatfs/cortina-app.bin */
	//BDK-CONFIG-BOOT-NEXT-STAGE-%s = "";

	/* BDK trace level. This is a bitmask of the enumeration defined in
	bdk-trace.h. Each bit turns on tracing of a specific BDK
	component. */
	//BDK-CONFIG-TRACE = "0";

	/* Determine how multi-node is supported for this system:
	    0 = Multi-node is not supported
	    1 = Multi-node is supported and booting requires two nodes
	    2 = Multi-node is auto detected. Two nodes are used if
	        if available, otherwise fall back to single node. */
	//MULTI-NODE = "2";
	MULTI-NODE = "0";

	/* Determine if internal PCIe ECAMs support Enhanced Allocation(EA):
	    0 = Enhanced Allocation is not supported
	    1 = Enhanced Allocation is supported
	Note EA is not supported on CN88XX pass 1.x, and is always
	disabled. */
	//PCIE-ENHANCED-ALLOCATION = "1";

	/* Enforcing stronger PCIe ordering. Use this option if a PCIe card
	is having compatibility issues.
	    0 = Don't wait for commit, default for best performance.
	    1 = Wait for commit, use conservative ordering. */
	//PCIE-ORDERING = "0";

	/* Force CCPI lane reversal. This should be set for boards which
	reverse the CCPI lanes between nodes. If lane 0 connects to lane
	23, this option is needed. CN88XX pass 2.0 and higher automatically
	detect lane reversal, so setting this is optional.
	    0 = Automatically detect lane reversal, no lane reversal on
	        CN88XX pass 1.x.
	    1 = Force lane reversal, required on CN88XX pass 1.0 with CCPI
	        lanes reversed. */
	//CCPI-LANE-REVERSE = "0";

	/* Cavium SKU for the chip. This is determined by early code and
	passed to later software for display. This should not be set in
	the input device tree, it will be ignored. */
	//CHIP-SKU.NODE%d = "TBD";

	/* For Cavium evaluation boards, query the MCU for QLM setup
	information. The MCU supplies a TWSI protocol for the SOC to
	query the modules plugged in and automatically set the QLMs to
	the correct mode. This should only be enabled(1) on Cavium
	EBB8XXX boards. Other boards should have it disabled(0). */
	//QLM-AUTO-CONFIG = "0";
	QLM-AUTO-CONFIG = "0";

	/* For Cavium SFF evaluation boards, query the DIP switch settings for DLM setup
	information. The DIP switches are connected to the GPIO pins which could be read to
	query the desired DLM configuration and automatically set the DLMs to
	the correct mode. This should only be enabled(1) on Cavium
	SFF81XX boards. Other boards should have it disabled(0). */
//	QLM-DIP-AUTO-CONFIG = "1";
	/* Set the mode of a QLM. The possible mode strings are:
	    DISABLED
	    PCIE_1X1
	    PCIE_2X1
	    PCIE_1X2
	    PCIE_1X4
	    PCIE_1X8
	    SATA_4X1
	    SATA_2X1
	    ILK
	    SGMII_4X1
	    SGMII_2X1
	    XAUI_1X4
	    RXAUI_2X2
	    RXAUI_1X2
	    OCI
	    XFI_4X1
	    XFI_2X1
	    XLAUI_1X4
	    10G_KR_4X1
	    10G_KR_2X1
	    40G_KR4_1X4 */
	//QLM-MODE.N%d.QLM%d = "";
	QLM-MODE.N0.QLM0 = "PCIE_1X4";
	QLM-MODE.N0.QLM4 = "XFI_2X1";
	QLM-MODE.N0.QLM5 = "SATA_2X1";
	QLM-MODE.N0.QLM6 = "SGMII_2X1";

	/* Set the speed of a QLM in Mhz. The possible speeds are:
	    1250
	    1500
	    2500
	    3000
	    3125
	    5000
	    6000
	    6250
	    8000
	   10312 */
	//QLM-FREQ.N%d.QLM%d = "0";
	QLM-FREQ.N0.QLM0 = "6000";
	QLM-FREQ.N0.QLM4 = "10312";
	QLM-FREQ.N0.QLM5 = "6000";
	QLM-FREQ.N0.QLM6 = "1250";

	/* Set the source of the QLM reference clock:
	    0 = Common clock 0
	    1 = Common clock 1
	    2 = QLM external reference */
	//QLM-CLK.N%d.QLM%d = "2";
	QLM-CLK.N0.QLM0 = "2";
	QLM-CLK.N0.QLM1 = "2";
	QLM-CLK.N0.QLM2 = "2";
	QLM-CLK.N0.QLM3 = "2";

	/* Setting of GSERX_LANEX_TX_CFG_0[CFG_TX_SWING] for the QLM. This
	should only be used for QLMs used for BGX and CCPI not using KR
	training. */
	//QLM-TUNING-TX-SWING.N%d.QLM%d.LANE%d = "-1";
	QLM-TUNING-TX-SWING.N0.QLM3.LANE0 = "13";
	QLM-TUNING-TX-SWING.N0.QLM3.LANE1 = "13";

	/* Setting of GSERX_LANEX_TX_PRE_EMPHASIS[CFG_TX_PREMPTAP] for the
	QLM. This should only be used for QLMs used for BGX and CCPI not
	using KR training. CFG_TX_PREMPTAP:
	    Bits[8:5] = Tx Post Tap; Bits[3:0] = Tx Pre Tap */
	//QLM-TUNING-TX-PREMPTAP.N%d.QLM%d.LANE%d = "-1";

	/* Setting of GSERX_LANEX_TX_CFG_3[PCS_SDS_TX_GAIN] for the QLM. This
	should only be used for QLMs used for BGX and CCPI not using KR
	training. */
	//QLM-TUNING-TX-GAIN.N%d.QLM%d.LANE%d = "-1";

	/* Setting of GSERX_LANEX_TX_CFG_3[CFG_TX_VBOOST_EN] for the QLM. This
	should only be used for QLMs used for BGX and CCPI not using KR
	training. */
	//QLM-TUNING-TX-VBOOST.N%d.QLM%d.LANE%d = "-1";

	/* The insertion loss at Nyquist rate (e.g. 5.125Ghz for XFI/XLAUI) in
	dB should be passed into the channel loss attribute. For CN8XXX,
	this attribute is only used for XFI/10GBASE-KR and
	XLAUI/40GBASE-KR4 links. If no channel loss attribute is provided
	the default value assumes a loss of greater than 10dB. */
	//QLM-CHANNEL-LOSS.N%d.QLM%d = "-1";

	/* Speed grade to use for DRAM in MT/s. Hardware may adjust this value
	slightly to improve DRAM stability, so scope measurements may not
	exactly match the frequency with MT/s. The Cavium supported speed
	grades are:
	    666 MT/s
	    800 MT/s
	    1066 MT/s
	    1333 MT/s
	    1600 MT/s
	    1866 MT/s
	    2133 MT/s (DDR4 only)
	Parameters:
	    N#: Parameter can be different for each node. This specifies
	        which node the value is for. Node must be 0-3. Optional. */
	//DDR-SPEED.N%d = "0";
	DDR-SPEED.N0 = "2133";

	/* TWSI address of the DIMM SPD. The encoding of this address is
	:    [15:12]: TWSI bus the DIMM is connected to.
	     [11:7]: Reserved, set to zero.
	      [6:0]: TWSI address for the DIMM.
	A value of zero means the DIMMs are not accessible. Hard coded
	values will be read from DDR-CONFIG-SPD-DATA.Parameters:
	    LMC#: Parameter can be different for memory controller. This
	        specifies which LMC the value is for. LMC must be
	        0-3. Optional.
	    N#: Parameter can be different for each node. This specifies
	        which node the value is for. Node must be 0-3. Optional. */
	//DDR-CONFIG-SPD-ADDR.DIMM%d.LMC%d.N%d = "0";
    DDR-CONFIG-SPD-ADDR.DIMM0.LMC0 = "0x0057";	/* TWSI0 Address 0x57 */

        /* Other DRAM settings are read from ddr4-common.dtsi */

	/* Specify a on-chip GPIO used to control power for a USB port. When
	set, the USB host controller will toggle the GPIO automatically
	during USB reset events. The default value assumes the SOC has no
	control of the USB power and it is always on. */
	//USB-PWR-GPIO.N%d.PORT%d = "-1";
	USB-PWR-GPIO.N0.PORT0 = "12";

	/* Specify the polarity of a on-chip GPIO used to control power for
	a USB port. The GPIO used is specified by USB-PWR-GPIO. Setting this
	GPIO low. The default value drives the GPIO high. */
	//USB-PWR-GPIO-POLARITY.N%d.PORT%d = "1";

	/* Specify reference clock source for SuperSpeed and HighSpeed PLL.
	Possible sources:
	 USB_REF_CLK pin
	Additional sources for CN81XX/CN80XX chips
	 DLMC_REF_CLK0 pin
	 DLMC_REF_CLK1 pin
	 PLL_REF_CLK
	Clock used by usb needs to run at 100MHz frequency except PLL_REF_CLK
	which requires 50MHz frequency.
	Encoding:
	0 - SS(USB_REF_CLK)   HS(USB_REF_CLK)
	1 - SS(DLMC_REF_CLK0) HS(DLMC_REF_CLK0)
	2 - SS(DLMC_REF_CLK1) HS(DLMC_REF_CLK1)
	3 - SS(USB_REF_CLK)   HS(PLL_REF_CLK)
	4 - SS(DLMC_REF_CLK0) HS(PLL_REF_CLK)
	5 - SS(DLMC_REF_CLK1) HS(PLL_REF_CLK)
	The default is 0 : USB_REF_CLK. */
	//USB-REFCLK-SRC.N%d.PORT%d = "0";
	USB-REFCLK-SRC.N0.PORT0 = "0";

	/* CN88XX SC and SNT parts have an errata where a GPIO is used to
	toggle DC_OK. For boards with SC and SNT parts, a GPIO must be wired
	per errata description. */
	//NITROX-GPIO.N%d = "-1";

	/* Number of reading with no errors to signal the start of an
	eye. The default value should be good for most cases. */
	//QLM-EYE-NUM-ZEROS = "2";

	/* Time to sample at each location in microseconds. The default
	value should be good for most cases. */
	//QLM-EYE-SAMPLE-TIME = "0x190";

	/* Time to settle after each movement in microseconds. The
	default value should be good for most cases. */
	//QLM-EYE-SETTLE-TIME = "0x32";

	/* Reference clock in Hz. CN88XX drives data on rising edges of this
	clock, and the target latches data on the falling edges of this
	clock. On reset CN88XX tristates SGPIO_SCLK. When not exchanging
	a bit stream CN88XX keeps SGPIO_SCLK low.
	  Min: 128 Hz
	  Max: 100 kHz */
	//SGPIO-SCLOCK-FREQ.N%d = "0x2710";

	/* Output pin number for SGPIO controller power control. */
	//SGPIO-PIN-POWER.N%d = "-1";

	/* Output pin number for SGPIO SCLOCK signal. */
	//SGPIO-PIN-SCLOCK.N%d = "-1";

	/* Output pin number for SGPIO SLOAD signal. */
	//SGPIO-PIN-SLOAD.N%d = "-1";

	/* Output pin number for SGPIO SDATAOUT[n] signal. n = 0..3. */
	//SGPIO-PIN-SDATAOUT.N%d.D%d = "-1";

	/* Temperature where THERMAL_TRIP_N is asserted. When the chip reaches
	this temperature THERMAL_TRIP_N will assert, signalling the board
	to emergency power off. The default value is the Cavium recommended
	maximum temperature of the chip. Values between 0 and 110 degrees
	Celsius. */
	//VRM-TEMP-TRIP.N%d = "0x6e";

	/* Temperature where maximum throttling is applied to the chip. Chip
	performance will be greatly reduced to keep the temperature below
	thermal trip (VRM-TEMP-TRIP). The default value is the Cavium
	recommended maximum operating temperature of the chip. Values
	between 0 and 110 degrees Celsius. */
	//VRM-TEMP-HIGH.N%d = "0x6e";

	/* Temperature where minimum throttling is applied to the chip. Chip
	performance will be maximized at or below this temperature. The
	throttling level will be set to VRM-THROTTLE-NORMAL. The default
	value is the Cavium recommended operating temperature of the chip.
	Values between 0 and 110 degrees Celsius. */
	//VRM-TEMP-LOW.N%d = "0x64";

	/* Throttle level of the chip when operating normally. Temperatures
	at or below VRM-TEMP-LOW will use this throttling level. The default
	level (70%), allows good performance while still reducing power under
	heavy loads. Value is a percentage between 1 and 100. */
	//VRM-THROTTLE-NORMAL.N%d = "0x41";

	/* Throttle level of the chip is overheating. Temperatures at or
	above VRM-TEMP-HIGH will use this throttling level. The default
	level (5%), allows for forward progress while still reducing power.
	Value is a percentage between 1 and 100. Setting a value of 100
	disables dynamic throttling (not recommended). */
	//VRM-THROTTLE-THERM.N%d = "0xf";
	
}; /* cavium,bdk */
}; /* / */
