/dts-v1/;

/include/ "ddr4-common.dtsi"
/include/ "gw630x.dtsi"

/ {
cavium,bdk {
	/*
	 * DRAM Configuration (differences from GW63xx)
	 */
	DDR-SPEED.N0 = "1333"; /* 666|800|1066|1333|1600|1866|2133 */
};
};
